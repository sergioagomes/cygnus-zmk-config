#include "cygnus.dtsi"

&default_kscan {
    row-gpios
        = <&pro_micro 21 (GPIO_ACTIVE_HIGH | GPIO_PULL_DOWN)>
        , <&pro_micro 18 (GPIO_ACTIVE_HIGH | GPIO_PULL_DOWN)>
        , <&pro_micro 16 (GPIO_ACTIVE_HIGH | GPIO_PULL_DOWN)>
        , <&pro_micro 10 (GPIO_ACTIVE_HIGH | GPIO_PULL_DOWN)>
        ;

    col-gpios
        = <&pro_micro 15 GPIO_ACTIVE_HIGH>   /* col0 - candidato TAB */
        , <&pro_micro 14 GPIO_ACTIVE_HIGH>   /* col1 - candidato Q   */
        , <&pro_micro  5 GPIO_ACTIVE_HIGH>   /* col2 - candidato W   */
        , <&pro_micro  6 GPIO_ACTIVE_HIGH>   /* col3 - E (confirmado) */
        , <&pro_micro  8 GPIO_ACTIVE_HIGH>   /* col4 - R (confirmado) */
        , <&pro_micro  9 GPIO_ACTIVE_HIGH>   /* col5 - T (confirmado) */
        ;
};
